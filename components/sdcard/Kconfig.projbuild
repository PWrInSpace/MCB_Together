## components/sdcard/Kconfig.projbuild
```kconfig
menu "SD Task"

    config SD_DATA_BUFFER_MAX_SIZE
        int "data buffer size"
        default 512

    config SD_LOG_BUFFER_MAX_SIZE
        int "log buffer size"
        default 256

    config SD_MOUNT_POINT
        string "mount_point"
        default "/sdcard"

    config SD_DATA_QUEUE_SIZE
        int "Data queue size"
        default 20

    config SD_LOG_QUEUE_SIZE
        int "Log queue size"
        default 20

    config SD_PATH_SIZE
        int "Path size"
        default 40

    config SD_DATA_DROP_VALUE
        int "Data drop value"
        range 0 SD_DATA_QUEUE_SIZE
        default 10

    config SD_TASK_STACK_DEPTH
        int "task stack depth"
        default 8100

    config SD_TASK_PRIORITY
        int "task priority"
        range 0 20
        default 5

    config SD_TASK_CORE_ID
        int "task core id"
        range 0 1
        default 1

    config SD_TASK_TRY_TO_MOUNT_DELAY
        int "Try to mount delay in ticks"
        default 1000

    config SD_MAX_DATA_RECEIVE
        int "Max data drop during one loop execution"
        default 25

endmenu
```

## components/sys/Kconfig.projbuild
```kconfig
menu "PinOut"
    
    config SCL_COM
        int "I2C num 1 (communication) scl pin"
        default 4

    config SDA_COM
        int "I2C num 1 (communication) sda pin"
        default 5

    config SCL_S
        int "I2C num 2 (sensors) scl pin"
        default 36

    config SDA_S
        int "I2C num 2 (sensors) sda pin"
        default 35

    config SPI_MEM_MOSI
        int "Spi memory mosi pin"
        default 12

    config SPI_MEM_MISO
        int "Spi memory miso pin"
        default 10

    config SPI_MEM_SCK
        int "Spi memory sck pin"
        default 11

    config SPI_COM_MOSI
        int "Spi communication mosi pin"
        default 14

    config SPI_COM_MISO
        int "Spi communication miso pin"
        default 21

    config SPI_COM_SCK
        int "Spi communication sck pin"
        default 47
        
endmenu
```
